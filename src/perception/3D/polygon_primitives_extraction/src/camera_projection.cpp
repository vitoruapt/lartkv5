/**************************************************************************************************
 Software License Agreement (BSD License)

 Copyright (c) 2011-2013, LAR toolkit developers - University of Aveiro - http://lars.mec.ua.pt
 All rights reserved.

 Redistribution and use in source and binary forms, with or without modification, are permitted
 provided that the following conditions are met:

  *Redistributions of source code must retain the above copyright notice, this list of
   conditions and the following disclaimer.
  *Redistributions in binary form must reproduce the above copyright notice, this list of
   conditions and the following disclaimer in the documentation and/or other materials provided
   with the distribution.
  *Neither the name of the University of Aveiro nor the names of its contributors may be used to
   endorse or promote products derived from this software without specific prior written permission.
 
 THIS SOFTWARE IS PROVIDED BY THE COPYRIGHT HOLDERS AND CONTRIBUTORS "AS IS" AND ANY EXPRESS OR
 IMPLIED WARRANTIES, INCLUDING, BUT NOT LIMITED TO, THE IMPLIED WARRANTIES OF MERCHANTABILITY AND
 FITNESS FOR A PARTICULAR PURPOSE ARE DISCLAIMED. IN NO EVENT SHALL THE COPYRIGHT HOLDER OR
 CONTRIBUTORS BE LIABLE FOR ANY DIRECT, INDIRECT, INCIDENTAL, SPECIAL, EXEMPLARY, OR CONSEQUENTIAL
 DAMAGES (INCLUDING, BUT NOT LIMITED TO, PROCUREMENT OF SUBSTITUTE GOODS OR SERVICES; LOSS OF USE,
 DATA, OR PROFITS; OR BUSINESS INTERRUPTION) HOWEVER CAUSED AND ON ANY THEORY OF LIABILITY, WHETHER
 IN CONTRACT, STRICT LIABILITY, OR TORT (INCLUDING NEGLIGENCE OR OTHERWISE) ARISING IN ANY WAY OUT
 OF THE USE OF THIS SOFTWARE, EVEN IF ADVISED OF THE POSSIBILITY OF SUCH DAMAGE.
***************************************************************************************************/
/**
 * @addtogroup camera_projection 
 * @{
 * @file
 * @brief performs the projection of a camera image to a polygonal primitive
 */
#ifndef _CAMERA_PROJECTION_CPP_
#define _CAMERA_PROJECTION_CPP_

#include "camera_projection.h"

int class_camera_projection::draw_pixels_projectable(cv::Mat* image, pcl::PointCloud<pcl::PointXYZRGB>* pc, const cv::Scalar color, int thickness)
{
	for (size_t i=0; i<pc->points.size(); i++)
	{
		cv::line(*image, cv::Point2d(pc->points[i].x, pc->points[i].y), cv::Point2d(pc->points[i].x, pc->points[i].y), color, thickness);
	}
	return 1;
}

int class_camera_projection::set_vertex_chull(const pcl::PointCloud<pcl::PointXYZ>::Ptr vertexes)	
{
	vertex_chull = *vertexes;
	return 1;
}

int class_camera_projection::create_polygon_from_pts_list(const pcl::PointCloud<pcl::PointXYZ>* vertexes, pcl::PointCloud<pcl::PointXYZ>* vertices)
{
	//Erase all points from the vertices vector
	vertices->erase(vertices->begin(), vertices->end());	

	for (size_t i=0; i<vertexes->size(); i++)
	{
		if (!isnan((vertexes->at(i)).x))
		{
			vertices->push_back(vertexes->at(i));	
		}
	}

	return 1;}


int class_camera_projection::set_image(const cv::Mat* image, ros::Time time, std::string name)
{
	stamp = time;

	//mask_hough.create(image->rows, image->cols, CV_8U);
	//mask_tmp.create(image->rows, image->cols, CV_8U);
	//image_hough.create(image->rows, image->cols, image->type());
	image_original.create(image->rows, image->cols, image->type());
	image_gui.create(image->rows, image->cols, image->type());
	image_corrected.create(image->rows, image->cols, image->type());
	image->copyTo(image_original);	
	//image_corrected.copyTo(image_hough);	

	//correct_image_distortion(&image_original, &image_corrected);
	correct_spherical_image_distortion(&image_original, &image_corrected);
	image_corrected.copyTo(image_gui);


	cv::cvtColor(image_corrected, image_gray, CV_RGB2GRAY);
	//cv::Canny(image_gray, mask_canny, 40, 150, 3, false);
	cv::Canny(image_gray, mask_canny, 190, 220, 3, false);
	//cv::Canny(image_gray, mask_canny, 40, 180, 5, false);
	//cv::dilate(mask_canny,mask_canny,cv::Mat(),cv::Point(-1,-1), 3);

	//cv::Sobel(image_gray, mask_canny, mask_canny.type(), 2, 2, 3, 1, 0, cv::BORDER_DEFAULT);


	mask_grid.create(image->rows, image->cols, CV_8U);
	mask_grid = cv::Mat::zeros(image->rows, image->cols, CV_8U);
	//for (int l=0; l<image->rows; l+=30)
	//for (int c=0; c<image->cols; c+=30)
	//cv::line(mask_grid, cv::Point2d(c,l), cv::Point2d(c,l), cv::Scalar(255), 1);

	mask_intersection.create(image->rows, image->cols, CV_8U);
	mask_intersection = cv::Mat::zeros(image->rows, image->cols, CV_8U);
	mask_projectable_pixels.create(image->rows, image->cols, CV_8U);
	mask_projectable_pixels = cv::Mat::zeros(image->rows, image->cols, CV_8U);

	create_image_canvas_for_known_camera(&image_corrected, &pixels_canvas,name);

	return 1;}


int class_camera_projection::create_image_canvas(const cv::Mat* image, std::vector<pcl::PointXY>* pts)
{
	pcl::PointXY pix;     

	//Create the canvas
	int c=0; int l=0; 
	for (l=image->rows-1; l>=0; l--) 
	{    
		pix.x = c; 
		pix.y = l; 
		pts->push_back(pix);
	}    

	c=0; l=0; 
	for (c=0; c<image->cols; c++) 
	{    
		pix.x = c; 
		pix.y = l; 
		pts->push_back(pix);
	}    

	c=image->cols-1; l=0; 
	for (l=0; l<image->rows; l++) 
	{    
		pix.x = c; 
		pix.y = l; 
		pts->push_back(pix);
	}    

	c=0; l=image->rows-1;
	for (c=image->cols-1; c>=0; c--) 
	{    
		pix.x = c; 
		pix.y = l; 
		pts->push_back(pix);
	}    

	return 1;}

int class_camera_projection::create_image_canvas_for_known_camera(const cv::Mat* image, std::vector<pcl::PointXY>* pts, std::string name)
{
	pcl::PointXY pix;     

	//printf("name=%s\n",name.c_str());
	if (name=="/tf_cam_roof_fc")
	{
		double Y[1297]={239, 239, 239, 239, 239, 239, 239, 239, 239, 239, 239, 239, 239,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 207, 
207, 208, 209, 210, 211, 212, 213, 214, 215, 216, 217, 218,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 239,
 239, 239, 239, 239, 239, 239, 239, 239, 239, 239, 239, 239,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 66, 
65, 64, 63, 62, 61, 60, 59, 58, 57, 56, 55, 54,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 0,
 0, 0, 0, 0, 0, 0, 0, 0, 0, 0, 0, 0,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 155, 
156, 157, 158, 159, 160, 161, 162, 163, 164, 165, 166, 167,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 238, 239}; 

		double X[1297]={0, 1, 2, 3, 4, 5, 6, 7, 8, 9, 10, 11, 12,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 187,
 188, 189, 190, 191, 192, 193, 194, 195, 196, 197, 198, 199,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 362, 
363, 364, 365, 366, 367, 368, 369, 370, 371, 372, 373, 374,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 375,
 375, 375, 375, 375, 375, 375, 375, 375, 375, 375, 375, 375,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 218, 
217, 216, 215, 214, 213, 212, 211, 210, 209, 208, 207, 206,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 0,
 0, 0, 0, 0, 0, 0, 0, 0, 0, 0, 0, 0,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 0, 0}; 




		for (int i=0; i<1297; i++) 
		{    
			pix.x = X[i]; 
			pix.y = Y[i]; 
			pts->push_back(pix);
		}    


	}
	else if (name=="/tf_cam_roof_fl")
	{

		double Y[1229]={239, 239, 239, 239, 239, 239, 239, 239, 239, 239, 239, 239, 239,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 239, 
239, 239, 239, 239, 239, 239, 239, 239, 239, 239, 239, 239,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 209,
 208, 207, 206, 205, 204, 203, 202, 201, 200, 199, 198, 197,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 0, 
0, 0, 0, 0, 0, 0, 0, 0, 0, 0, 0, 0,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 0, 
0, 0, 0, 0, 0, 1, 2, 3, 4, 5, 6, 7,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 223, 
224, 225, 226, 227, 228, 229, 230, 231, 232, 233, 234, 235, 236, 237, 238, 239}; 

		double X[1229]={0, 1, 2, 3, 4, 5, 6, 7, 8, 9, 10, 11, 12,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 222, 
223, 224, 225, 226, 227, 228, 229, 230, 231, 232, 233, 234,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 375,
 375, 375, 375, 375, 375, 375, 375, 375, 375, 375, 375, 375,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 358, 
357, 356, 355, 354, 353, 352, 351, 350, 349, 348, 347, 346,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 153,
 152, 151, 150, 149, 148, 147, 146, 145, 144, 143, 142, 141,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 0,
 0, 0, 0, 0, 0, 0, 0, 0, 0, 0, 0, 0,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 0, 0}; 


		for (int i=0; i<1229; i++) 
		{    
			pix.x = X[i]; 
			pix.y = Y[i]; 
			pts->push_back(pix);
		}    
	}
	else if (name=="/tf_cam_roof_fr")
	{
		double Y[1228]={239, 239, 239, 239, 239, 239, 239, 239, 239, 239, 239, 239, 239,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 239, 
239, 239, 239, 239, 239, 239, 239, 239, 239, 239, 239, 239,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 209,
 208, 207, 206, 205, 204, 203, 202, 201, 200, 199, 198, 197,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 0, 
0, 0, 0, 0, 0, 0, 0, 0, 0, 0, 0, 0,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 32, 
33, 34, 35, 36, 37, 38, 39, 40, 41, 42, 43, 44,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 215, 
216, 217, 218, 219, 220, 221, 222, 223, 224, 225, 226, 227, 228, 229, 230, 231, 232, 233, 234, 235, 236, 237, 238, 239}; 

		double X[1228]={0, 1, 2, 3, 4, 5, 6, 7, 8, 9, 10, 11, 12,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 222, 
223, 224, 225, 226, 227, 228, 229, 230, 231, 232, 233, 234,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 375,
 375, 375, 375, 375, 375, 375, 375, 375, 375, 375, 375, 375,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 358, 
357, 356, 355, 354, 353, 352, 351, 350, 349, 348, 347, 346,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 153,
 152, 151, 150, 149, 148, 147, 146, 145, 144, 143, 142, 141,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 0,
 0, 0, 0, 0, 0, 0, 0, 0, 0, 0, 0, 0,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 0, 0}; 





		for (int i=0; i<1228; i++) 
		{    
			pix.x = X[i]; 
			pix.y = Y[i]; 
			pts->push_back(pix);
		}

	}
	else if (name=="/tf_cam_roof_rc" || name=="/tf_cam_roof_fc_6mm")
	{
		double Y[1229]={239, 239, 239, 239, 239, 239, 239, 239, 239, 239, 239, 239, 239,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 239, 
239, 239, 239, 239, 239, 239, 239, 239, 239, 239, 239, 239,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 209,
 208, 207, 206, 205, 204, 203, 202, 201, 200, 199, 198, 197,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 0, 
0, 0, 0, 0, 0, 0, 0, 0, 0, 0, 0, 0,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 0, 
0, 0, 0, 0, 0, 1, 2, 3, 4, 5, 6, 7,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 223, 
224, 225, 226, 227, 228, 229, 230, 231, 232, 233, 234, 235, 236, 237, 238, 239}; 

		double X[1229]={0, 1, 2, 3, 4, 5, 6, 7, 8, 9, 10, 11, 12,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 222, 
223, 224, 225, 226, 227, 228, 229, 230, 231, 232, 233, 234,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 375,
 375, 375, 375, 375, 375, 375, 375, 375, 375, 375, 375, 375,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 358, 
357, 356, 355, 354, 353, 352, 351, 350, 349, 348, 347, 346,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 153,
 152, 151, 150, 149, 148, 147, 146, 145, 144, 143, 142, 141,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 0,
 0, 0, 0, 0, 0, 0, 0, 0, 0, 0, 0, 0,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 0, 0}; 

		for (int i=0; i<1229; i++) 
		{    
			pix.x = X[i]; 
			pix.y = Y[i]; 
			pts->push_back(pix);
		}
	}
	else //camera not known, standard image canvas
	{
		create_image_canvas(image, pts);
	}



	return 1;}

int class_camera_projection::draw_pixels_vector(cv::Mat* image, std::vector<pcl::PointXY>* pts, const cv::Scalar color, int thickness)
{
	for (size_t i=0; i<pts->size(); i++)
	{
		cv::line(*image, cv::Point2d((pts->at(i)).x, (pts->at(i)).y), cv::Point2d((pts->at(i)).x, (pts->at(i)).y), color, thickness);
	}

	return 1;}

int class_camera_projection::draw_pixels_vector_as_polyline(cv::Mat* image, std::vector<pcl::PointXY>* pts, const cv::Scalar color, int thickness)
{
	for (size_t i=1; i<pts->size(); i++)
	{
		cv::line(*image, cv::Point2d((pts->at(i-1)).x, (pts->at(i-1)).y), cv::Point2d((pts->at(i)).x, (pts->at(i)).y), color,thickness);
	}
	cv::line(*image, cv::Point2d((pts->at(pts->size()-1)).x, (pts->at(pts->size()-1)).y), cv::Point2d((pts->at(0)).x, (pts->at(0)).y), color,thickness);

	return 1;}


float class_camera_projection::get_weight_for_pixel(int l, int c, double resolution_factor, float px, float py, float pz)
{
	pcl::PointXYZRGB pt;
	pcl::PointCloud<pcl::PointXYZRGB> pix;
	pcl::PointCloud<pcl::PointXYZRGB> vex;

	pt.x = c;
	pt.y = l;
	pt.z = 0;
	pix.push_back(pt);

	project_pixel_with_color_to_vertex(&pix, &vex);

	float dist = sqrt(
			(px-vex.points[0].x)*(px-vex.points[0].x)+
			(py-vex.points[0].y)*(py-vex.points[0].y)+
			(pz-vex.points[0].z)*(pz-vex.points[0].z)
			);

	if (dist>40) dist=40;
	if (dist<1) dist=1;
	float dist_factor = 1-(dist-1)/(40-1); //dist is now from 0-1
	return (dist_factor*resolution_factor);
}



void class_camera_projection::compute_projectable_pixels(void)
{
	cv::Point** pts;
	pts = (cv::Point**) malloc(sizeof(cv::Point*));
	pts[0] = (cv::Point*) malloc(pixels_intersection.size()*sizeof(cv::Point));

	for (int i=0; i<(int)pixels_intersection.size(); i++)
	{
		pts[0][i].x = round(pixels_intersection[i].x);
		pts[0][i].y = round(pixels_intersection[i].y);	
	}

	int* npts;
	npts = (int*) malloc(sizeof(int));
	npts[0] = (int) pixels_intersection.size();

	cv::Scalar s(255);
	cv::fillPoly(mask_intersection, (const cv::Point**) &(*pts), &(*npts), 1, s);	

	cv::bitwise_or(mask_grid, mask_canny, mask_projectable_pixels);
	cv::bitwise_and(mask_projectable_pixels, mask_intersection, mask_projectable_pixels);

	//This is required to erase any pixels near the border. They are added directly from the vertex_intersection, so that floating point roundings to pixel do not project vertices outside the camera_intersection polygon
	//for (int i=1; i<(int)pixels_intersection.size(); i++)
	//{
	//cv::line(mask_projectable_pixels, cv::Point2d(pixels_intersection[i-1].x,pixels_intersection[i-1].y), cv::Point2d(pixels_intersection[i].x,pixels_intersection[i].y), cv::Scalar(0), 1);
	//}
	//cv::line(mask_projectable_pixels, cv::Point2d(pixels_intersection[pixels_intersection.size()-1].x,pixels_intersection[pixels_intersection.size()-1].y), cv::Point2d(pixels_intersection[0].x,pixels_intersection[0].y), cv::Scalar(0), 1);

	//add the pixels intersection
	for (int i=1; i<(int)pixels_intersection.size(); i++)
	{
		cv::line(mask_projectable_pixels, cv::Point2d(pixels_intersection[i-1].x,pixels_intersection[i-1].y), cv::Point2d(pixels_intersection[i].x,pixels_intersection[i].y), cv::Scalar(255), 1);
	}

	//Hough lines 
	//lines.erase(lines.begin(), lines.end());
	//mask_projectable_pixels.copyTo(mask_tmp);
	//cv::HoughLinesP( mask_tmp, lines, 1, 0.1*CV_PI/180, 150, 40, 20 );


	//cv::bitwise_or(mask_projectable_pixels, mask_intersection, mask_projectable_pixels);

	//mask_hough = cv::Mat::zeros(mask_hough.rows, mask_hough.cols, CV_8U);
	//for( size_t i = 0; i < lines.size(); i++ )
	//{
		//cv::line( image_hough, cv::Point(lines[i][0], lines[i][1]),	cv::Point(lines[i][2], lines[i][3]), cv::Scalar(0,0,255), 1, 8 );
		//cv::line( mask_hough, cv::Point(lines[i][0], lines[i][1]),	cv::Point(lines[i][2], lines[i][3]), cv::Scalar(255), 1, 8 );
	//}

	
	//cv::bitwise_or(mask_projectable_pixels, mask_hough, mask_projectable_pixels);


	//erase the list of pixels projectable
	pixels_projectable.erase(pixels_projectable.begin(), pixels_projectable.end());


	for (int l=0; l<mask_projectable_pixels.rows; l++)
		for (int c=0; c<mask_projectable_pixels.cols; c++)
		{
			if (mask_projectable_pixels.at<unsigned char>(l,c)) //in this case should project
			{
				//printf("projecting pix c=%d l=%d\n",c,l);
				pcl::PointXYZRGB pt; //must use this because there is no XYRGB
				pt.x = c;
				pt.y = l;
				pt.z = NAN;

				unsigned char r = image_corrected.at<t_pixel>(l,c)[0];
				unsigned char g = image_corrected.at<t_pixel>(l,c)[1];
				unsigned char b = image_corrected.at<t_pixel>(l,c)[2];
				uint32_t rgb = ((uint32_t)b << 16 | (uint32_t)g << 8 | (uint32_t)r);
				pt.rgb = *reinterpret_cast<float*>(&rgb);

				pixels_projectable.push_back(pt);
			}	
		}

	for (int i=0; i<(int)pixels_intersection.size(); i++)
	{
		pcl::PointXYZRGB pt; //must use this because there is no XYRGB
		pt.x = pixels_intersection[i].x;
		pt.y = pixels_intersection[i].y;
		pt.z = NAN;

		unsigned char r = image_corrected.at<t_pixel>(pt.y,pt.x)[0];
		unsigned char g = image_corrected.at<t_pixel>(pt.y,pt.x)[1];
		unsigned char b = image_corrected.at<t_pixel>(pt.y,pt.x)[2];
		uint32_t rgb = ((uint32_t)b << 16 | (uint32_t)g << 8 | (uint32_t)r);
		pt.rgb = *reinterpret_cast<float*>(&rgb);

		pixels_projectable.push_back(pt);
	}

}

int class_camera_projection::compute_pixel_list_to_vertex_list(pcl::ModelCoefficientsPtr coeff)
{
	set_projection_plane(coeff->values[0], coeff->values[1], coeff->values[2], coeff->values[3]);
	project_pixel_with_color_to_vertex(&pixel_list, &vertex_list);
	vertex_list.height=1;
	vertex_list.header.frame_id="/world";
// 	vertex_list.header.stamp=ros::Time::now();
    ROS_ERROR("Cloud timestamp not set, problem during migration lar3 to lar4");
	vertex_list.is_dense=0;
	vertex_list.width=vertex_list.points.size();
	return 1;
}


#endif
/**
 *@}
 */      
